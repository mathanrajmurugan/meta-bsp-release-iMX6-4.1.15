## conf/layer.conf
```bitbake
# Let bitbake find our .bbclass and .conf files
BBPATH .= ":${LAYERDIR}"

# Let bitbake know where to look for .bb and .bbappend files
BBFILES += "${LAYERDIR}/recipes-*/*/*.bb \
            ${LAYERDIR}/recipes-*/*/*.bbappend"

#BBFILE_COLLECTIONS += "sbca62"
#BBFILE_COLLECTIONS += "seco_928_quad_1gb"

BBFILE_PATTERN_sbca62 := "^${LAYERDIR}/"
BBFILE_PRIORITY_sbca62 = "6"

BBFILE_PATTERN_seco_928_quad_1gb := "^${LAYERDIR}/"
BBFILE_PRIORITY_seco_928_quad_1gb = "6"
```

## conf/machine/seco-a62hmi-qd-256mbx4.conf
```bitbake
#@TYPE: Machine
#@NAME: SECO A62HMI board
#@SOC: i.MX6 QUAD
#@DESCRIPTION: Machine configuration for SECO A62HMI board

require conf/machine/include/imx-base.inc
require conf/machine/include/tune-cortexa9.inc

SOC_FAMILY = "mx6:mx6q"

#SCMVERSION = "n"
PREFERRED_PROVIDER_u-boot_mx6 ??= "u-boot-seco"
PREFERRED_PROVIDER_u-boot_mx6q ??= "u-boot-seco"
PREFERRED_PROVIDER_virtual/bootloader_mx6 ??="u-boot-seco"
PREFERRED_VERSION_u-boot-seco = "2015.04"

UBOOT_CONFIG ??= "sd"
UBOOT_CONFIG[sd] = "mx6q_SBC_A62_10_256MBx4_defconfig"
UBOOT_MAKE_TARGET = ""

do_rootfs[depends] += "sbc-bootscript-sdupdate:do_deploy"
BOOT_SCRIPTS = "bootscript-update"


PREFERRED_PROVIDER_virtual/kernel_seco-a62hmi-qd-256mbx4 = "linux-seco"
PREFERRED_PROVIDER_virtual/kernel_mx6 = "linux-seco"
PREFERRED_PROVIDER_virtual/kernel_mx6q = "linux-seco"
PREFERRED_PROVIDER_virtual/kernel = "linux-seco"
PREFERRED_VERSION_linux-seco = "4.1.15"

KERNEL_DEVICETREE = "imx6q-seco_SBC_A62-10.dtb"

SERIAL_CONSOLE = "115200 ttymxc1"

KERNEL_IMAGETYPE = "zImage"
MACHINE_FEATURES += "wifi"
MACHINE_EXTRA_RRECOMMENDS += ""
PREFERRED_PROVIDER_virtual/mesa = ""
```

## conf/machine/seco-b08.conf
```bitbake
#@TYPE: Machine
#@NAME: SECO B08 board
#@SOC: i.MX6 SOLOX
#@DESCRIPTION: Machine configuration for SECO B08 board

require conf/machine/include/imx-base.inc
require conf/machine/include/tune-cortexa9.inc

SOC_FAMILY = "mx6:mx6sx"

#SCMVERSION = "n"
PREFERRED_PROVIDER_u-boot_mx6 ??= "u-boot-seco-solox"
PREFERRED_PROVIDER_u-boot_mx6sx ??= "u-boot-seco-solox"
PREFERRED_PROVIDER_virtual/bootloader_mx6 ??="u-boot-seco-solox"
PREFERRED_VERSION_u-boot-seco-solox = "2015.04"

UBOOT_CONFIG ??= "sd"
UBOOT_CONFIG[sd] = "seco_b08_defconfig"
UBOOT_MAKE_TARGET = ""

do_rootfs[depends] += "sbc-bootscript-sd:do_deploy"
BOOT_SCRIPTS = "bootscript"

IMAGE_INSTALL_append = " wilink8-fw "
IMAGE_INSTALL_append = " bluetoothstart "
IMAGE_INSTALL_append = " fix-xorg-conf "
IMAGE_INSTALL_append = " installscript "
IMAGE_INSTALL_append = " uimsys "

USER_CLASSES += " fiximage "
IMAGE_POSTPROCESS_COMMAND += " fix_boot_image "

PREFERRED_PROVIDER_virtual/kernel_seco-b08 = "linux-seco-solox"
PREFERRED_PROVIDER_virtual/kernel_mx6 = "linux-seco-solox"
PREFERRED_PROVIDER_virtual/kernel_mx6sx = "linux-seco-solox"
PREFERRED_PROVIDER_virtual/kernel = "linux-seco-solox"
PREFERRED_VERSION_linux-seco-solox = "4.1.15"

KERNEL_DEVICETREE = "imx6sx-seco-b08-basic-lvds7.dtb imx6sx-seco-b08-full-lvds7.dtb imx6sx-seco-b08-full-rgb7.dtb imx6sx-seco-b08-basic-rgb7.dtb"

SERIAL_CONSOLE = "115200 ttymxc1"

KERNEL_IMAGETYPE = "zImage"
MACHINE_FEATURES += "wifi"
MACHINE_EXTRA_RRECOMMENDS += ""
PREFERRED_PROVIDER_virtual/mesa = ""
```
